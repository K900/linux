## drivers/clk/cix/Kconfig
```kconfig
# SPDX-License-Identifier: GPL-2.0
# Audio subsystem clock support for Cixtech SoC family
menu "Clock support for Cixtech audss"

config CLK_SKY1_ACPI
	tristate "CIX Sky1 ACPI clock lookup table support"
	depends on ACPI && COMMON_CLK_SCMI
	depends on ARM64
	default ARCH_CIX
	help
	  Parses CLKT tables in the CIX Sky1 DSDT to connect ACPI
	  consumer devices with SCMI-provided clocks. Required for
	  ACPI boot on Sky1 SoCs.

config CLK_SKY1_AUDSS
	tristate "Cixtech Sky1 Audio Subsystem Clock Driver"
	depends on ARCH_CIX || COMPILE_TEST
	select AUXILIARY_BUS
	select REGMAP_MMIO
	select RESET_CONTROLLER
	help
	  Support for the Audio Subsystem clock controller present on
	  Cixtech Sky1 SoC. This driver provides mux, divider and gate
	  clocks for DSP, I2S, HDA and related blocks in the audio
	  subsystem. Say M or Y here if you want to build this driver.
endmenu
```

## drivers/net/wireless/mediatek/mt76/mt7996/Kconfig
```kconfig
# SPDX-License-Identifier: BSD-3-Clause-Clear
config MT7996E
	tristate "MediaTek MT7996 (PCIe) support"
	select MT76_CONNAC_LIB
	select WANT_DEV_COREDUMP
	select RELAY
	depends on MAC80211
	depends on PCI
	help
	  This adds support for MT7996-based PCIe wireless devices,
	  which support concurrent tri-band operation at 6GHz, 5GHz,
	  and 2.4GHz IEEE 802.11be 4x4:4SS 4096-QAM, 320MHz channels.

	  To compile this driver as a module, choose M here.

config MT7996_NPU
	bool "MT7996 (PCIe) NPU support"
	depends on MT7996E
	depends on NET_AIROHA_NPU=y || MT76_CORE=NET_AIROHA_NPU
	select MT76_NPU
	default n

config MT7996E_EXT_BSSID_STAS
	bool "Enable EXT_BSSID stations for mt7996 driver"
	default n
	depends on MT7996E
	help
	  Since the combined-phy rework of the driver, station links
	  allocated with these MUAR indices have not worked. Without
	  this enabled, these links will be disabled, and the interface
	  configurations will be updated accordingly.
```

## drivers/thermal/cix/Kconfig
```kconfig
# SPDX-License-Identifier: GPL-2.0-only

config CIX_THERMAL
	bool "CIX thermal IPA support"
	depends on ARCH_CIX || COMPILE_TEST
	depends on THERMAL && THERMAL_GOV_POWER_ALLOCATOR
	depends on CPU_FREQ && ENERGY_MODEL
	depends on ACPI_CPPC_CPUFREQ
	select CIX_SCMI_ENERGY_MODEL
	help
	  Power allocator (IPA) support for CIX platforms, including the
	  cpu-ipa MMIO driver for per-CPU static/dynamic power, ACPI thermal
	  zone methods (SSTP, SWIT), CPPC OPP data, and processor cooling
	  device power callbacks.

	  If unsure, say Y on CIX Sky1 systems using the power_allocator
	  thermal governor.

config CIX_SCMI_ENERGY_MODEL
	tristate "SCMI based Cix Energy Model driver"
	depends on ENERGY_MODEL
	depends on CIX_THERMAL
	depends on ARM_SCMI_PROTOCOL
	help
	  It uses SCMI Message Protocol and SCMI performance domain helpers
	  to register Energy Model (EM) for Cix platforms. Supports both
	  genpd-bound devices and DT-based domain ID parsing.
```
